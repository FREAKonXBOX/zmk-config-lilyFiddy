## config/west.yml
```yaml
manifest:
  remotes:
    - name: zmkfirmware
      url-base: https://github.com/zmkfirmware
    - name: prospector
      url-base: https://github.com/t-ogura
    - name: penguinchat
      url-base: https://github.com/penguinchat
  projects:
    projects:
    - name: zmk
      remote: zmkfirmware
      revision: v0.3
      import: app/west.yml
    - name: prospector-zmk-module
      remote: prospector
      revision: v2.0.0
      path: modules/prospector-zmk-module
    - name: zmk-dongle-screen
      remote: penguinchat
      revision: Penguinchat-patch-1
    - name: zmk-for-PandaKB.com-
      remote: penguinchat
      revision: PandaKB_Lily58
  self:
    path: config
```
